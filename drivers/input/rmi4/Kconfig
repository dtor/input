## drivers/input/rmi4/Kconfig
```kconfig
#
# RMI4 configuration
#
config RMI4_CORE
	tristate "Synaptics RMI4 bus support"
	help
	  Say Y here if you want to support the Synaptics RMI4 bus.  This is
	  required for all RMI4 device support.

	  If unsure, say Y.

	  This feature is not currently available as a loadable module.

config RMI4_DEBUG
	bool "RMI4 Debugging"
	depends on RMI4_CORE
	select DEBUG_FS
	help
	  Say Y here to enable debug feature in the RMI4 driver.

	  Note that the RMI4 driver debug features can generate a lot of
	  output (potentially clogging up your dmesg output) and generally
	  slow down driver operation.  It's recommended to enable them only
	  if you are actively developing/debugging RMI4 features.

	  If unsure, say N.

config RMI4_I2C
	tristate "RMI4 I2C Support"
	depends on RMI4_CORE && I2C
	help
	  Say Y here if you want to support RMI4 devices connected to an I2C
	  bus.

	  If unsure, say Y.

	  This feature is not currently available as a loadable module.

config RMI4_F11
	tristate "RMI4 Function 11 (2D pointing)"
	depends on RMI4_CORE
	help
	  Say Y here if you want to add support for RMI4 function 11.

	  Function 11 provides 2D multifinger pointing for touchscreens and
	  touchpads.  For sensors that support relative pointing, F11 also
	  provides mouse input.

	  To compile this driver as a module, choose M here: the
	  module will be called rmi-f11.

config RMI4_F11_PEN
	bool "RMI4 F11 Pen Support"
	depends on RMI4_F11
	help
	  Say Y here to add support for pen input to RMI4 function 11.

	  If this feature is enabled, when pen inputs are detected they
	  will be reported to the input stream as MT_TOOL_PEN.  Otherwise,
	  pens will be treated the same as fingers.

	  Not all UI implementations deal gracefully with pen discrimination.
	  If your system is not recognizing pen touches and you know your
	  sensor supports pen input, you probably want to turn this feature
	  off.
```
